AUTOSAR XML (schema 00048)
package /AUTOSAR_PduR/EcucModuleDefs
  module definition PduR [0..1]: category=VENDOR_SPECIFIC_MODULE_DEFINITION, post-build-variant-support=true, refined-module-def=PduR, variants post-build/pre-compile  # Configuration of the PduR (PDU Router) module.
    container PduRBswModules [0..*]: multiplicity set at pre-compile  # Each container describes a specific BSW module (upper/CDD/lower/IpduM) that the PDU Router shall interface to. | The reason to have it as own configuration container instead of implication of the routing path is to be able to configure CDDs properly and to force module's to be used in a post-build situation even though no routing is made to/from this module (future configurations may include these modules).
      boolean PduRCancelReceive: set at pre-compile  # Specifies if the Transport protocol module supports the CancelReceive API or not. Value true the API is supported.
      boolean PduRCancelTransmit: set at pre-compile  # Specifies if the BSW module supports the CancelTransmit API or not. Value true the API is supported.
      boolean PduRCommunicationInterface: set at pre-compile  # Specifies if the BSW module supports the Communication Interface APIs or not. Value true the APIs are supported. | A module can have both Communication Interface APIs and Transport Protocol APIs (e.g. the COM module).
      boolean PduRCopyRxData [0..0]: scope=ECU, set at pre-compile  # Specifies if the Transport protocol module supports the CopyRxData API or not. Value true the API is supported.
      boolean PduRCopyTxData [0..0]: scope=ECU, set at pre-compile  # Specifies if the Transport protocol module supports the CopyTxData API or not. Value true the API is supported.
      boolean PduRLowerModule: set at pre-compile  # The PduRLowerModule will decide who will call the APIs and who will implement the APIs. | For example, if the CanIf module is referenced then the PDU Router module will implement the PduR_CanIfRxIndication API. And the PDUR module will call the CanIf_Transmit API. Other APIs are of course also covered. An upper module can also be an lower module (e.g. the IpduM module).
      boolean PduRReleaseRxBuffer [0..1]: scope=ECU, set at pre-compile, default-value=false  # Specifies if BSW module supports the ReleaseRxBuffer API or not. Value true the API is supported. Tags: atp.Status=draft
      boolean PduRRetransmission [0..0]: set at pre-compile  # If set to true this means that the destination transport protocol module will use the retransmission feature. This parameter might be set to false if the retransmission feature is not used, even though the destination transport protocol is supporting it. | This parameter is only valid for transport protocol modules and gateway operations. If transmission from a local upper layer module this module will handle the retransmission.
      boolean PduRRxIndication [0..0]: scope=ECU, set at pre-compile  # Specifies if BSW module supports the RxIndication API or not. Value true the API is supported.
      boolean PduRStartOfReception [0..0]: scope=ECU, set at pre-compile  # Specifies if the Transport protocol module supports the StartOfReception API or not. Value true the API is supported.
      boolean PduRTpRxIndication [0..0]: scope=ECU, set at pre-compile  # Specifies if the Transport protocol module supports the TpRxIndication API or not. Value true the API is supported.
      boolean PduRTpTransmit [0..0]: scope=ECU, set at pre-compile  # Specifies if BSW module supports the TP Transmit API or not. Value true the API is supported.
      boolean PduRTpTxConfirmation [0..0]: scope=ECU, set at pre-compile  # Specifies if the Transport protocol module supports the TpTxConfirmation API or not. Value true the API is supported.
      boolean PduRTransmit [0..0]: scope=ECU, set at pre-compile  # Specifies if BSW module supports the (IF) Transmit API or not. Value true the API is supported.
      boolean PduRTransportProtocol: set at pre-compile  # The PDU Router module shall use the API parameters specified for transport protocol interface.
      boolean PduRTriggertransmit: set at pre-compile  # Specifies if the BSW module supports the TriggerTransmit API or not. Value true means that the BSW module supports the TriggerTransmit interface which a lower layer module can call and also that it can call the TriggerTransmit interface of an upper layer module. Value false means that the BSW module does not support the TriggerTransmit interface which a lower layer module can call and also that it shall not call the TriggerTransmit interface of an upper layer module.
      boolean PduRTxConfirmation: set at pre-compile  # Specifies if the BSW module supports the TxConfirmation API or not. Value true the API is supported.
      boolean PduRUpperModule: set at pre-compile  # The PduRUpperModule will decide who will call the APIs and who will implement the APIs. | For example, if the COM module is referenced then the PDU Router module will implement the PduR_Transmit API. And the PDUR module will call the Com_RxIndication API. Other APIs are of course also covered. An upper module can also be an lower module (e.g. the IpduM module).
      boolean PduRUseTag [0..0]: set at pre-compile  # This parameter, if set to true, enables the usage of the tag (<up>) in the following API calls: | * PduR_<Up>CancelReceive * PduR_<Up>CancelTransmit Example: If used by COM and the parameter is enabled the PduR_ComCancelTransmit is used. The background is that upper layer modules differ in usage of this tag (e.g. COM is using the tag, DCM is not).
      foreign reference PduRBswModuleRef: set at pre-compile, destination-type=ECUC-MODULE-CONFIGURATION-VALUES  # This is a reference to one BSW module's configuration (i.e. not the ECUC parameter definition template). | Example, there could be several configurations of LinIf and this reference selects one of them.
      container PduRRbInvalidHandlers [0..1]: multiplicity set at pre-compile  # Container for each PduRBswModule to indicate whether Invalid Handlers should be supported or not for any feature. This is relevant only for a lower layer module. This container need not be configured
        boolean PduRRbIHCancelReceive: origin=RB:1:0:0:2016-08-30, set at pre-compile, default-value=false  # Specifies for a PduRBswModule, if call to Invalid Handler needs to be generated instead of actual CancelReceive API.Value TRUE: Call to Invalid Handler is generated.Value FALSE: Call to Actual ModuleName_CancelReceive API is generated.
        boolean PduRRbIHCancelTransmit: origin=RB:1:0:0:2016-08-30, set at pre-compile, default-value=false  # Specifies for a PduRBswModule, if call to Invalid Handler needs to be generated instead of actual CancelTransmit API. Value TRUE: Call to Invalid Handler is generated.Value FALSE: Call to Actual ModuleName_CancelTransmit API is generated
    container PduRGeneral  # This container is a subcontainer of PduR and specifies the general configuration parameters of the PDU Router.
      boolean PduRDevErrorDetect: set at pre-compile, default-value=false  # Switches the development error detection and notification on or off. | * true: detection and notification is enabled. * false: detection and notification is disabled.
      boolean PduRMetaDataSupport [0..0]: multiplicity set at pre-compile, set at pre-compile, default-value=false  # Enable support for MetaData handling. The MetaData is defined by the referenced MetaDataType of the global PDU definitions. This feature may be used for efficient address based routing and generic CAN-CAN-routing, where the MetaData contains the CAN ID.
      boolean PduRRbDisablePostBuildSelectableVariants [0..1]: multiplicity set at pre-compile, origin=RB:4:0:0:2022-10-06, set at pre-compile, default-value=false  # This parameter enables and disables a PostBuild Selectable support in PostBuild variant. This parameter will not affect the precompile variant. False : PduR will be PBS in PBS environment. True : PduR will be Pre-Compile in PBS environment
      boolean PduRRbDsmReInitEnabled [0..1]: multiplicity set at pre-compile, origin=RB:1.0.0:2017-03-10, set at pre-compile, default-value=false  # PduRRbDSMReInitEnabled | Enables or disables the reporting of DEM events to DSM after the Re-initialisation of DSM has occured.
      float PduRRbDsmReInitMainFunctionPeriod [0..1]: 0.001..1, multiplicity set at pre-compile, origin=RB:1.0.0:2017-03-10, set at pre-compile  # Specifies the period in seconds that the MainFunction has to be triggered with. Comment:this main function is used for DsmReinit feature.
      boolean PduRRbGwTpWithLimitedBuffer [0..1]: multiplicity set at pre-compile, origin=RB:1:0:0:2018-09-21, set at pre-compile, default-value=false  # Configuration parameter to enable or disable PDU Router support for gateway Tp using limited buffer resources; Note : When this parameter is set true need to configure PduRTpThreshold.
      boolean PduRRbIFGatewayOperation: origin=RB:1:0:0:2016-08-30, set at pre-compile  # Configuration parameter to enable or disable PDU Router IF Gateway from an interface module to lower layer interface modules; if PDUR_ZERO_COST_OPERATION is enabled, this parameter has to be disabled.This parameter shall be seen as an input requirement to the configuration generator.
      boolean PduRRbMulticastFromTpSupport: origin=RB:1:0:0:2016-08-30, set at pre-compile  # Configuration parameter to enable or disable PDU Router support for multicasts from a TP module to upper layer modules and lower layer TP modules; if PDUR_ZERO_COST_OPERATION is enabled, this parameter has to be disabled.This parameter shall be seen as an input requirement to the configuration generator. For Example : LoTp (Src)->PduR->(Dest1)LoTp, (Dest2)UpTp
      boolean PduRRbMulticastToIfSupport: origin=RB:1:0:0:2016-08-30, set at pre-compile  # Configuration parameter to enable or disable PDU Router support for multicasts from an upper layer module to interface modules; if PDUR_ZERO_COST_OPERATION is enabled, this parameter has to be disabled.This parameter shall be seen as an input requirement to the configuration generator.
      boolean PduRRbMulticastToTpSupport: origin=RB:1:0:0:2016-08-30, set at pre-compile  # Configuration parameter to enable or disable PDU Router support for multicasts from an upper layer module to TP modules; if PDUR_ZERO_COST_OPERATION is enabled, this parameter has to be disabled.This parameter shall be seen as an input requirement to the configuration generator.
      boolean PduRRbQueueingSupport: origin=RB:1:0:0:2016-08-30, set at pre-compile  # Configuration parameter to enable or disable PDU Router Queueing Feature. If PDUR_ZERO_COST_OPERATION is enabled, this parameter has to be disabled.
      boolean PduRRbTPGatewayOperation: origin=RB:1:0:0:2016-08-30, set at pre-compile  # Configuration parameter to enable or disable PDU Router TP gateway from a TP module to lower layer TP modules; if PDUR_ZERO_COST_OPERATION is enabled, this parameter has to be disabled.This parameter shall be seen as an input requirement to the configuration generator.
      boolean PduRVersionInfoApi: set at pre-compile, default-value=false  # If true the PduR_GetVersionInfo API is available.
      boolean PduRZeroCostOperation: set at pre-compile  # If set the PduR configuration generator will report an error if zero-cost-operation cannot be fulfilled. | This parameter shall be seen as an input requirement to the configuration generator.
      container PduRRbDemSupport [0..1]: multiplicity set at pre-compile  # This container containes switches for Dem Monitoring Control.
        boolean PduRRbInitFailed: origin=RB:1.0.0:2017-03-1, set at pre-compile  # Monitoring Control Switch for error PDUR_E_INIT_FAILED.This parameter shall be seen as an input requirement to the configuration generator.
        boolean PduRRbPduInstanceLost: origin=RB:1.0.0:2017-03-1, set at pre-compile  # Monitoring Control Switch for error PDUR_E_PDU_INSTANCE_LOST.This parameter shall be seen as an input requirement to the configuration generator.
    container PduRRoutingPaths  # Represents one table of routing paths. | This routing table allows multiple configurations that can be used to create several routing tables in the same configuration. This is mainly used for post-build (e.g. post-build selectable) but can be used by pre-compile and link-time for variant handling.
      integer PduRConfigurationId: 0..65535, post-build-variant-value=true, set at post-build in variant post-build / pre-compile in variant pre-compile  # Identification of the configuration of the PduR configuration. This identification can be read using the PduR API.
      integer PduRMaxRoutingPathCnt [0..0]: 0..65535, multiplicity set at pre-compile, set at pre-compile  # Maximum number of RoutingPaths in all RoutingTables. This parameter is needed only in case of post-build loadable implementation using static memory allocation.
      integer PduRMaxRoutingPathGroupCnt [0..0]: 0..65535, multiplicity set at pre-compile, set at pre-compile  # Maximum number of RoutingPathGroups. This parameter is needed only in case of post-build loadable implementation using static memory allocation.
      container PduRDestPdu [0..*]: multiplicity set at post-build in variant post-build / pre-compile in variant pre-compile, post-build-variant-multiplicity=true  # This container is a subcontainer of PduRRoutingPath and specifies one destination for the PDU to be routed.
        enumeration PduRDestPduDataProvision [0..1]: {PDUR_DIRECT, PDUR_TRIGGERTRANSMIT}, multiplicity set at post-build in variant post-build / pre-compile in variant pre-compile, post-build-variant-multiplicity=true, post-build-variant-value=true, set at post-build in variant post-build / pre-compile in variant pre-compile  # Specifies how data are provided: direct (as part of the Transmit call) or via | the TriggerTransmit callback function. Only required for non-TP gatewayed I-PDUs.
        integer PduRDestPduHandleId [0..1]: 0..65535, scope=ECU, multiplicity set at pre-compile, set at pre-compile, symbolic-name-value=true, with-auto=true  # PDU identifier assigned by PDU Router. Used by communication interface and transport protocol modules for confirmation (PduR_<Lo>TxConfirmation) and for TriggerTransmit (PduR_<Lo>TriggerTransmit).
        boolean PduRTransmissionConfirmation [0..0]: multiplicity set at pre-compile, set at pre-compile  # This parameter is only for communication interfaces. Transport protocol modules will always call the TxConfirmation function. | If set the destination communication interface module will call the TxConfirmation. However the TxConfirmation may be not called due to error. So the PduR shall not block until the TxConfirmation is called. One background for this parameter is for the PduR to know when all modules have confirmed a multicast operation.
        reference PduRDestPduRef: post-build-variant-value=true, set at post-build in variant post-build / pre-compile in variant pre-compile, destination=Pdu  # Destination PDU reference; reference to unique PDU identifier which shall be used by the PDU Router instead of the source PDU ID when calling the related function of the destination module.
      container PduRRbDemEventParameterRefs [0..1]: multiplicity set at pre-compile  # Container for the references to DemEventParameter elements which shall be invoked using the API Dem_ReportErrorStatus API in case the corresponding error occurs. The EventId is taken from the referenced DemEventParameter's DemEventId value. The standardized errors are provided in the container and can be extended by vendor specific error references.
        enumeration PduRRbDynCreate_E_INIT_FAILED [0..1]: {Disabled, Standard}, multiplicity set at pre-compile, origin=RB:0.1.0:2014-10-08, set at pre-compile, default-value=Disabled  # Dynamically create PDUR_E_INIT_FAILED DemEvent | Selects the way how the PDUR_E_INIT_FAILED DemEvent is created. If not set or set to Disabled, no such DemEvent is automatically created. If the dynamic creation of this DemEvent is enabled, the reference to this DemEvent (in parameter PDUR_E_INIT_FAILED) is also automatically created and shall therefore not be set manually.
        enumeration PduRRbDynCreate_E_PDU_INSTANCE_LOST [0..1]: {Disabled, Standard}, multiplicity set at pre-compile, origin=RB:0.1.0:2014-10-08, set at pre-compile, default-value=Disabled  # Dynamically create PDUR_E_PDU_INSTANCE_LOST DemEvent | Selects the way how the PDUR_E_PDU_INSTANCE_LOST DemEvent is created. If not set or set to Disabled, no such DemEvent is automatically created. If the dynamic creation of this DemEvent is enabled, the reference to this DemEvent (in parameter PDUR_E_PDU_INSTANCE_LOST) is also automatically created and shall therefore not be set manually.
        symbolic name reference PDUR_E_INIT_FAILED [0..1]: multiplicity set at pre-compile, origin=RB:0.1.0:2020-05-08, set at pre-compile, destination=DemEventParameter  # Reference to configured DEM event to report PDU Router initialization failed (PDU Router changed to PDUR_REDUCED state).
        symbolic name reference PDUR_E_PDU_INSTANCE_LOST [0..1]: multiplicity set at pre-compile, origin=RB:0.1.0:2020-05-08, set at pre-compile, destination=DemEventParameter  # Reference to configured DEM event to report Loss of a PDU instance (FIFO flushed because of an overrun).
      container PduRRbTpBufferPool [0..*]: multiplicity set at pre-compile  # Specifies a pool of buffers used for gateway through TP.
        integer PduRRbTpPoolHandleId: 0..65534, origin=RB:1:0:0:2016-08-30, set at pre-compile, with-auto=true  # Unique Handle Id for accessing Buffer Pools
        container PduRRbTpPoolBuffer [1..*]: multiplicity set at pre-compile  # Specifies a buffer used for gateway through TP.
          integer PduRRbLengthOfTpBufferInPool: 1..65535, origin=RB:1:0:0:2016-08-30, set at pre-compile  # Length of the TP buffer in number of bytes
          integer PduRRbTpPoolBufferCopies: 1..65535, origin=RB:1:0:0:2016-08-30, set at pre-compile  # The number of copies required for this buffer
      container PduRRoutingPath [0..*]: multiplicity set at post-build in variant post-build / pre-compile in variant pre-compile, post-build-variant-multiplicity=true  # This container is a subcontainer of PduRRoutingTable and specifies the routing path of a PDU.
        integer PduRQueueDepth [0..1]: 1..255, multiplicity set at post-build in variant post-build / pre-compile in variant pre-compile, post-build-variant-multiplicity=true, post-build-variant-value=true, set at post-build in variant post-build / pre-compile in variant pre-compile, default-value=1  # This parameter defines the queue depth for this routing path.
        integer PduRRbTpGatewayQueueDepth [0..1]: 1.., multiplicity set at pre-compile, origin=RB:1:0:0:2016-08-30, set at pre-compile  # This parameter specifies whether queue is required in Tp Gatewaying or not. If configured as 2 then, queuing is enabled. Max queue depth can be 2. By default the parameter value is 1. NOTE: Configure parameter TpGatewayQueueDepth if queueing feature is required. Configure PduRQueueDepth if FIFO TP feature is required.
        boolean PduRRbTpHandleFirstFrame [0..1]: origin=RB:1:0:0:2024-05-31, set at pre-compile, default-value=false  # Configuration parameter to make sure first Frame is always accepted in PDU Router TP gateway operaton. In this case, after Rx of first frame, FC wait shall be sent by Tp module before sending consecutive frame. Gateway-on-the-fly shall be disabled if this is enabled.
        integer PduRRbFirstFrameBufLength [0..1]: 6..60, multiplicity set at post-build in variant post-build / pre-compile in variant pre-compile, origin=RB:1:0:0:2024-05-31, post-build-variant-multiplicity=true, post-build-variant-value=true, set at post-build in variant post-build / pre-compile in variant pre-compile, default-value=6  # PduRFirstFrameBufferLength | Length of the buffer in bytes required to store the First frame while gatewaying CanTP Frames. Set this value specific to the type of Can frame: Default value is set as per Standard Can message which has FF length 6 bytes. For CanFd frames, FF length is typically 58, hence this value is to be set to 58 in those cases. Size is limited to a maximum of 60 bytes because it is only meant to store FirstFrame; not the consecutive frames.
        integer PduRTpThreshold [0..1]: 0..65535, multiplicity set at post-build in variant post-build / pre-compile in variant pre-compile, post-build-variant-multiplicity=true, post-build-variant-value=true, set at post-build in variant post-build / pre-compile in variant pre-compile  # This parameter is only relevant for TP routings. | When configured, it enables on-the-fly routing and defines the number of bytes which must have been received before transmission on the destination bus may start. When omitted, direct TP routing is enforced. The PduRouter shall ensure that a buffer is allocated for this routing path which is at least as large as the threshold.
        reference PduRDestPduRRef: post-build-variant-value=true, set at post-build in variant post-build / pre-compile in variant pre-compile, destination=PduRDestPdu
        choice reference PduRDestTxBufferRef [0..*]: multiplicity set at post-build in variant post-build / pre-compile in variant pre-compile, post-build-variant-multiplicity=true, post-build-variant-value=true, set at post-build in variant post-build / pre-compile in variant pre-compile, destination=PduRTxBuffer  # Reference to a buffer in the PduR. This buffer is required for communication interface gatewaying, and for transport protocol gatewaying.
        choice reference PduRRbDestTpBufferRef [0..1]: multiplicity set at pre-compile, origin=RB:1:0:0:2016-08-30, set at pre-compile, destination=PduRRbTpBufferPool  # Reference to a buffer that is allocated in the PduRRbTpBufferPool. Having a global (for PduR) list of buffers allows reusage and hence less memory consumption.
        reference PduRRoutingPathGroupRef [0..1]: multiplicity set at post-build in variant post-build / pre-compile in variant pre-compile, post-build-variant-multiplicity=true, post-build-variant-value=true, set at post-build in variant post-build / pre-compile in variant pre-compile, destination=PduRRoutingPathGroup  # Reference to routing path destinations.
        reference PduRRbRoutingPathSeqGroupRef [0..1]: multiplicity set at pre-compile, origin=RB:1.0.0:2024-09-18, set at pre-compile, destination=PduRRbRoutingPathSeqGroup  # Reference to routing path Sequence Configuration parameter to maintain transmit sequence across the routing paths in PDU Router TP gateway operaton. In this case, Pdu Tx of one RP is controlled if another RP (where same reference is configured) pdu is already in transmission. Tx of this RP pdu shall be done in TxConf API..
        reference PduRSrcPduRRef: post-build-variant-value=true, set at post-build in variant post-build / pre-compile in variant pre-compile, destination=PduRSrcPdu
        container PduRDefaultValue [0..1]: multiplicity set at pre-compile, post-build-variant-multiplicity=true  # Specifies the default value of the I-PDU. Only required for gateway operation and if at least one PDU specified by PduRDestPdu uses TriggerTransmit Data provision. | Represented as an array of IntegerParamDef.
          container PduRDefaultValueElement [0..*]: multiplicity set at post-build in variant post-build / pre-compile in variant pre-compile, post-build-variant-multiplicity=true  # Each value element is represented by the element and the position in an array.
            integer PduRDefaultValueElement: 0..255, post-build-variant-value=true, set at post-build in variant post-build / pre-compile in variant pre-compile  # The default value consists of a number of elements. Each element is one byte long and the number of elements is specified by SduLength. The position of this parameter in the container is specified by the PduRElementBytePosition parameter.
            integer PduRDefaultValueElementBytePosition: 0..4294967294, post-build-variant-value=true, set at post-build in variant post-build / pre-compile in variant pre-compile  # This parameter specifies the byte position of the element within the default value
      container PduRRoutingPathGroup [0..*]: multiplicity set at post-build in variant post-build / pre-compile in variant pre-compile, post-build-variant-multiplicity=true  # This container groups routing path destinations. Destinations are used instead of routing paths since a routing path can be 1:n. It is desirable to be able to enable/disable a specific bus (i.e. a destination) rather than a routing path. Of course it is possible to create groups that covers specific routing paths as well. | Enabling and disabling of routing path groups are made using the PduR API
        boolean PduRIsEnabledAtInit: post-build-variant-value=true, set at post-build in variant post-build / pre-compile in variant pre-compile  # If set to true this routing path group will be enabled after initializing the PDU Router module (i.e. enabled in the PduR_Init function).
        integer PduRRoutingPathGroupId: 0..65535, scope=ECU, set at pre-compile, symbolic-name-value=true, with-auto=true  # Identification of the routing group. | The identification will be used by the disable/enable API in the PDU Router module API.
      container PduRRbRoutingPathSeqGroup [0..*]: multiplicity set at pre-compile  # This container groups routing paths which are to be part of perticular sequence routing .
      container PduRSrcPdu [0..*]: multiplicity set at pre-compile, post-build-variant-multiplicity=true  # This container is a subcontainer of PduRRoutingPath and specifies the source of the PDU to be routed.
        integer PduRSourcePduBlockSize [0..0]: 1..4294967295, multiplicity set at post-build in variant post-build / pre-compile in variant pre-compile, post-build-variant-multiplicity=true, post-build-variant-value=true, set at post-build in variant post-build / pre-compile in variant pre-compile  # Minimum amount of buffer space required by receiving transport protocol layer to continue reception.
        integer PduRSourcePduHandleId: 0..65535, scope=ECU, set at pre-compile, symbolic-name-value=true, with-auto=true  # PDU identifier assigned by PDU Router.
        boolean PduRSrcPduUpTxConf [0..0]: scope=ECU, multiplicity set at post-build in variant post-build / pre-compile in variant pre-compile, post-build-variant-multiplicity=true, post-build-variant-value=true, set at post-build in variant post-build / pre-compile in variant pre-compile, default-value=true  # When enabled, the TxConfirmation will be | forwarded to the upper layer. Prerequisites: Lower layer and upper layer support TxConfirmation.
        reference PduRSrcPduRef: post-build-variant-value=true, set at post-build in variant post-build / pre-compile in variant pre-compile, destination=Pdu  # Source PDU reference; reference to unique PDU identifier which shall be used for the requested PDU Router operation.
      container PduRTxBuffer [0..*]: multiplicity set at pre-compile  # Specifies a buffer used for gatewaying via communication interfaces or transport protocols.
        integer PduRPduMaxLength: 1..4294967295, set at pre-compile  # Length of the Tx buffer in bytes. This parameter limits the size of buffered routed PDUs.
